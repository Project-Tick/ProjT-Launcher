## cmark/Kconfig
```kconfig
# Kconfig - CommonMark Markdown parser
# Included from main Kconfig

menuconfig CMARK
	bool "cmark - CommonMark parser"
	default y
	help
	  CommonMark-compliant Markdown parser and renderer.
	  Used for news display and documentation rendering.

if CMARK

config CMARK_VERSION
	string "cmark version"
	default "0.31.1"

config CMARK_STATIC
	bool "Build as static library"
	default y
	help
	  Build cmark as a static library.

config CMARK_SHARED
	bool "Build as shared library"
	default n
	help
	  Also build cmark as a shared library.

menu "Extensions"

config CMARK_GFM_EXTENSIONS
	bool "GitHub Flavored Markdown extensions"
	default y
	help
	  Enable GFM extensions: tables, autolinks, strikethrough, etc.

config CMARK_EXT_TABLE
	bool "Table extension"
	default y
	depends on CMARK_GFM_EXTENSIONS
	help
	  GFM-style table support.

config CMARK_EXT_STRIKETHROUGH
	bool "Strikethrough extension"
	default y
	depends on CMARK_GFM_EXTENSIONS
	help
	  ~~strikethrough~~ text support.

config CMARK_EXT_AUTOLINK
	bool "Autolink extension"
	default y
	depends on CMARK_GFM_EXTENSIONS
	help
	  Automatically convert URLs to links.

config CMARK_EXT_TAGFILTER
	bool "Tag filter extension"
	default y
	depends on CMARK_GFM_EXTENSIONS
	help
	  Filter dangerous HTML tags.

config CMARK_EXT_TASKLIST
	bool "Task list extension"
	default y
	depends on CMARK_GFM_EXTENSIONS
	help
	  GitHub-style task list checkboxes.

endmenu

menu "Rendering"

config CMARK_RENDER_HTML
	bool "HTML rendering"
	default y
	help
	  Enable HTML output rendering.

config CMARK_RENDER_XML
	bool "XML rendering"
	default n
	help
	  Enable XML output rendering.

config CMARK_RENDER_MAN
	bool "Man page rendering"
	default n
	help
	  Enable man page output rendering.

config CMARK_RENDER_COMMONMARK
	bool "CommonMark rendering"
	default n
	help
	  Enable CommonMark (normalized) output.

config CMARK_RENDER_LATEX
	bool "LaTeX rendering"
	default n
	help
	  Enable LaTeX output rendering.

endmenu

menu "Safety"

config CMARK_SAFE
	bool "Safe mode"
	default y
	help
	  Enable safe mode which sanitizes raw HTML and URLs.

config CMARK_VALIDATE_UTF8
	bool "Validate UTF-8 input"
	default y
	help
	  Validate that input is valid UTF-8.

endmenu

config CMARK_TESTS
	bool "Build tests"
	default n
	depends on BUILD_TESTS

endif # CMARK
```

## defconfig
```kconfig
# ProjT Launcher default configuration
CONFIG_BUILD_RELEASE=y
CONFIG_QT_VERSION_MAJOR=6
CONFIG_QT_VERSION_MINOR=8
CONFIG_QT_VERSION_PATCH=0
CONFIG_QT_BUNDLED=y
CONFIG_FEATURE_JAVA_DOWNLOADER=y
CONFIG_QT_MODULE_QTWEBENGINE=y
CONFIG_FEATURE_LAUNCHER_HUB=y

# Qt Modules
CONFIG_QT_MODULE_QTBASE=y
CONFIG_QT_MODULE_QTNETWORKAUTH=y
CONFIG_QT_MODULE_QTIMAGEFORMATS=y
CONFIG_QT_MODULE_QTWEBCHANNEL=y
# CONFIG_QT_STATIC is not set
CONFIG_QT_SHARED=y

# Qt Platform Plugins (Linux)
CONFIG_QT_PLATFORM_XCB=y
CONFIG_QT_PLATFORM_WAYLAND=y
CONFIG_QT_PLATFORM_OFFSCREEN=y

# Qt Features
CONFIG_QT_FEATURE_CONCURRENT=y
CONFIG_QT_FEATURE_XML=y
CONFIG_QT_FEATURE_DBUS=y
CONFIG_QT_FEATURE_OPENGL=y
CONFIG_QT_FEATURE_OPENSSL=y
CONFIG_QT_FEATURE_ZSTD=y
CONFIG_QT_FEATURE_ACCESSIBILITY=y
CONFIG_QT_FEATURE_WIDGETS=y

CONFIG_CROSS_COMPILE=""
CONFIG_SYSROOT=""
CONFIG_CC=""
CONFIG_CXX=""
CONFIG_AR=""
CONFIG_STRIP=""
CONFIG_CFLAGS_EXTRA=""
CONFIG_CXXFLAGS_EXTRA=""
CONFIG_LDFLAGS_EXTRA=""

CONFIG_MOD_LAUNCHER=y
CONFIG_MOD_BUILD_CONFIG=y
CONFIG_MOD_PROGRAM_INFO=y
CONFIG_MOD_SYSTEMINFO=y
CONFIG_MOD_LAUNCHERJAVA=y
CONFIG_MOD_JAVACHECK=y
CONFIG_MOD_RAINBOW=y
CONFIG_MOD_LOCALPEER=y
CONFIG_MOD_GAMEMODE=y
CONFIG_MOD_MURMUR2=y
CONFIG_MOD_QDCSS=y
CONFIG_MOD_ZLIB=y
CONFIG_MOD_LIBPNG=y
CONFIG_MOD_BZIP2=y
CONFIG_MOD_MINIZIP=y
CONFIG_MOD_QUAZIP=y
CONFIG_MOD_TOMLPLUSPLUS=y
CONFIG_MOD_CMARK=y
CONFIG_MOD_LIBQRENCODE=y
CONFIG_MOD_LIBNBTPLUSPLUS=y

CONFIG_BUILD_TESTS=n
CONFIG_BUILD_FUZZERS=n
```

## gamemode/Kconfig
```kconfig
# Kconfig performance optimization
# Included from main Kconfig

menuconfig GAMEMODE
	bool "gamemode - Linux performance client"
	default y
	depends on TARGET_LINUX || TARGET_AUTO
	help
	  Client library for Feral Interactive's GameMode daemon.
	  Enables performance optimizations when running games.

if GAMEMODE

config GAMEMODE_VERSION
	string "gamemode version"
	default "1.8.2"

menu "Features"

config GAMEMODE_AUTO_START
	bool "Auto-start GameMode with game launch"
	default y
	help
	  Automatically request GameMode when launching a game.

config GAMEMODE_AUTO_STOP
	bool "Auto-stop GameMode when game exits"
	default y
	help
	  Automatically release GameMode when game exits.

config GAMEMODE_CHECK_DAEMON
	bool "Check for GameMode daemon"
	default y
	help
	  Check if gamemoded is running before trying to use it.

endmenu

menu "Optimizations"

config GAMEMODE_CPU_GOVERNOR
	bool "CPU governor optimization"
	default y
	help
	  Request CPU governor change to performance mode.

config GAMEMODE_GPU_OPTIMIZATION
	bool "GPU optimization"
	default y
	help
	  Request GPU clock/power optimizations.

config GAMEMODE_IO_PRIORITY
	bool "I/O priority boost"
	default y
	help
	  Request I/O priority boost for game process.

config GAMEMODE_PROCESS_NICE
	bool "Process nice value"
	default y
	help
	  Request lower nice value for game process.

config GAMEMODE_SCHEDULER
	bool "Scheduler optimization"
	default y
	help
	  Request scheduler optimizations (SCHED_ISO if available).

endmenu

menu "Integration"

config GAMEMODE_DBUS
	bool "D-Bus integration"
	default y
	help
	  Use D-Bus to communicate with gamemoded.

config GAMEMODE_FALLBACK_LIB
	bool "Fallback to library call"
	default y
	help
	  Fall back to direct library calls if D-Bus fails.

endmenu

endif # GAMEMODE
```

## libnbtplusplus/Kconfig
```kconfig
# libnbtplusplus Kconfig - Minecraft NBT parser
# Included from main Kconfig

menuconfig LIBNBTPLUSPLUS
	bool "libnbtplusplus - NBT parser"
	default y
	depends on LIB_ZLIB
	help
	  C++ library for reading and writing Minecraft NBT
	  (Named Binary Tag) format files.

if LIBNBTPLUSPLUS

config LIBNBTPLUSPLUS_STATIC
	bool "Build as static library"
	default y

config LIBNBTPLUSPLUS_SHARED
	bool "Build as shared library"
	default n

menu "Compression Support"

config LIBNBTPLUSPLUS_GZIP
	bool "Gzip compression"
	default y
	depends on LIB_ZLIB
	help
	  Support reading/writing gzip-compressed NBT files.
	  Most Minecraft NBT files use gzip compression.

config LIBNBTPLUSPLUS_ZLIB
	bool "Zlib compression (deflate)"
	default y
	depends on LIB_ZLIB
	help
	  Support raw zlib (deflate) compression.

config LIBNBTPLUSPLUS_UNCOMPRESSED
	bool "Uncompressed NBT"
	default y
	help
	  Support reading/writing uncompressed NBT files.

endmenu

menu "Tag Types"

comment "All standard NBT tag types are always enabled"

config LIBNBTPLUSPLUS_TAG_LONG_ARRAY
	bool "Long array support (TAG_Long_Array)"
	default y
	help
	  Support for TAG_Long_Array (added in Minecraft 1.12).

endmenu

menu "Features"

config LIBNBTPLUSPLUS_PRETTY_PRINT
	bool "Pretty-print support"
	default y
	help
	  Enable human-readable NBT output.

config LIBNBTPLUSPLUS_STRICT_PARSING
	bool "Strict parsing mode"
	default n
	help
	  Enable strict NBT parsing (reject malformed data).

config LIBNBTPLUSPLUS_MEMORY_MAPPING
	bool "Memory-mapped file I/O"
	default n
	help
	  Use memory-mapped files for faster reading.

endmenu

menu "Limits"

config LIBNBTPLUSPLUS_MAX_DEPTH
	int "Maximum nesting depth"
	default 512
	help
	  Maximum allowed nesting depth for compound/list tags.

config LIBNBTPLUSPLUS_MAX_STRING_SIZE
	int "Maximum string size (bytes)"
	default 65535
	help
	  Maximum allowed string length in bytes.

config LIBNBTPLUSPLUS_MAX_ARRAY_SIZE
	int "Maximum array size (elements)"
	default 16777216
	help
	  Maximum allowed byte/int/long array size.

endmenu

config LIBNBTPLUSPLUS_TESTS
	bool "Build tests"
	default n
	depends on BUILD_TESTS

endif # LIBNBTPLUSPLUS
```

## libpng/Kconfig
```kconfig
# libpng Kconfig - PNG library configuration
# Included from main Kconfig

menuconfig LIBPNG
	bool "libpng - PNG image support"
	default y
	depends on LIB_ZLIB
	help
	  PNG (Portable Network Graphics) image reading/writing library.
	  Required for icon and image handling.

if LIBPNG

config LIBPNG_VERSION
	string "libpng version"
	default "1.6.43"

menu "Hardware Optimizations"

config LIBPNG_ARM_NEON
	bool "ARM NEON intrinsics"
	default y
	depends on ARCH_AARCH64 || ARCH_ARM
	help
	  Enable ARM NEON SIMD optimizations for PNG decompression.

config LIBPNG_INTEL_SSE
	bool "Intel SSE intrinsics"
	default y
	depends on ARCH_X86_64 || ARCH_X86
	help
	  Enable Intel SSE2 SIMD optimizations.

config LIBPNG_MIPS_MSA
	bool "MIPS MSA intrinsics"
	default y
	depends on ARCH_MIPS64
	help
	  Enable MIPS MSA SIMD optimizations.

config LIBPNG_POWERPC_VSX
	bool "PowerPC VSX intrinsics"
	default y
	depends on ARCH_PPC64LE
	help
	  Enable PowerPC VSX vector optimizations.

config LIBPNG_LOONGARCH_LSX
	bool "LoongArch LSX intrinsics"
	default y
	depends on ARCH_LOONGARCH64
	help
	  Enable LoongArch LSX SIMD optimizations.

endmenu

menu "Features"

config LIBPNG_READ
	bool "PNG reading support"
	default y
	help
	  Enable PNG image reading/decoding.

config LIBPNG_WRITE
	bool "PNG writing support"
	default y
	help
	  Enable PNG image writing/encoding.

config LIBPNG_SIMPLIFIED_API
	bool "Simplified API"
	default y
	help
	  Enable the simplified read/write API (png_image_*).

config LIBPNG_APNG
	bool "APNG support (animated PNG)"
	default y
	help
	  Enable animated PNG (APNG) support.

config LIBPNG_READ_USER_TRANSFORM
	bool "User transform callback (read)"
	default y
	depends on LIBPNG_READ
	help
	  Allow user-defined pixel transformation during read.

config LIBPNG_WRITE_USER_TRANSFORM
	bool "User transform callback (write)"
	default y
	depends on LIBPNG_WRITE
	help
	  Allow user-defined pixel transformation during write.

config LIBPNG_PROGRESSIVE_READ
	bool "Progressive reading"
	default y
	depends on LIBPNG_READ
	help
	  Enable progressive/incremental PNG reading.

config LIBPNG_CHECK_FOR_INVALID_INDEX
	bool "Check for invalid palette index"
	default y
	help
	  Check for and warn about invalid palette indices.

config LIBPNG_BENIGN_ERRORS
	bool "Benign error handling"
	default y
	help
	  Allow app to override handling of benign errors.

endmenu

menu "Optional Chunks"

config LIBPNG_READ_ANCILLARY_CHUNKS
	bool "Read ancillary chunks"
	default y
	depends on LIBPNG_READ

config LIBPNG_READ_TEXT
	bool "Read text chunks (tEXt, iTXt, zTXt)"
	default y
	depends on LIBPNG_READ_ANCILLARY_CHUNKS

config LIBPNG_READ_GAMMA
	bool "Read gamma correction (gAMA)"
	default y
	depends on LIBPNG_READ_ANCILLARY_CHUNKS

config LIBPNG_READ_ICC_PROFILE
	bool "Read ICC profiles (iCCP)"
	default y
	depends on LIBPNG_READ_ANCILLARY_CHUNKS

endmenu

endif # LIBPNG
```

## quazip/Kconfig
```kconfig
# quazip Kconfig - Qt ZIP archive library
# Included from main Kconfig

menuconfig QUAZIP
	bool "quazip - Qt ZIP library"
	default y
	depends on LIB_ZLIB && LIB_BZIP2
	help
	  Qt wrapper for zlib/minizip providing ZIP archive
	  reading and writing functionality.

if QUAZIP

config QUAZIP_VERSION
	string "quazip version"
	default "1.4"

config QUAZIP_STATIC
	bool "Build as static library"
	default y

config QUAZIP_SHARED
	bool "Build as shared library"
	default n

menu "Compression Support"

config QUAZIP_DEFLATE
	bool "Deflate compression (zlib)"
	default y
	help
	  Standard ZIP deflate compression via zlib.

config QUAZIP_BZIP2
	bool "Bzip2 compression"
	default y
	depends on LIB_BZIP2
	help
	  Bzip2 compression support in ZIP archives.

config QUAZIP_ZSTD
	bool "Zstd compression"
	default y
	help
	  Zstandard compression support (ZIP extension).

config QUAZIP_LZMA
	bool "LZMA/XZ compression"
	default n
	help
	  LZMA compression support (requires liblzma).

endmenu

menu "Features"

config QUAZIP_ZIP64
	bool "ZIP64 support"
	default y
	help
	  Support for ZIP64 extensions (files > 4GB).

config QUAZIP_ENCRYPTION
	bool "ZIP encryption"
	default y
	help
	  Support for traditional ZIP encryption.
	  Note: ZIP encryption is weak, use encrypted containers instead.

config QUAZIP_AES_ENCRYPTION
	bool "AES encryption (WinZip)"
	default n
	depends on QUAZIP_ENCRYPTION
	help
	  Support for AES-256 encryption (WinZip extension).

config QUAZIP_UNICODE
	bool "Unicode filename support"
	default y
	help
	  Support for UTF-8 filenames in ZIP archives.

config QUAZIP_STREAMING
	bool "Streaming API"
	default y
	help
	  Enable QIODevice-based streaming read/write.

endmenu

menu "Memory"

config QUAZIP_BUFFER_SIZE
	int "I/O buffer size (bytes)"
	default 65536
	help
	  Size of internal read/write buffers.

config QUAZIP_MEMORY_LIMIT
	int "Memory limit for extraction (MB, 0=unlimited)"
	default 0
	help
	  Limit memory usage during extraction.
	  Prevents zip bomb attacks. 0 = no limit.

endmenu

config QUAZIP_TESTS
	bool "Build tests"
	default n
	depends on BUILD_TESTS

endif # QUAZIP
```
