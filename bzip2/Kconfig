## bzip2/Kconfig
```kconfig
# bzip2 Kconfig - Compression library
# Included from main Kconfig

menuconfig BZIP2
	bool "bzip2 - Compression library"
	default y
	help
	  High-quality data compression library using the
	  Burrows-Wheeler transform algorithm.

if BZIP2

config BZIP2_VERSION
	string "bzip2 version"
	default "1.0.8"

config BZIP2_STATIC
	bool "Build as static library"
	default y

config BZIP2_SHARED
	bool "Build as shared library"
	default n

menu "Features"

config BZIP2_SMALL
	bool "Small memory mode"
	default n
	help
	  Trade speed for memory usage. Uses ~2.5x less memory
	  but is ~2x slower.

config BZIP2_FAST
	bool "Fast mode"
	default n
	help
	  Trade compression ratio for speed.
	  Faster but produces larger output.

endmenu

menu "Limits"

config BZIP2_MAX_BLOCK_SIZE
	int "Maximum block size (100k multiplier, 1-9)"
	default 9
	range 1 9
	help
	  Maximum block size for compression (1=100k, 9=900k).
	  Larger = better compression but more memory.

config BZIP2_WORK_FACTOR
	int "Work factor (0-250)"
	default 30
	range 0 250
	help
	  Controls fallback algorithm threshold.
	  0 = use default (30).

endmenu

config BZIP2_BUILD_TOOLS
	bool "Build bzip2 command-line tools"
	default n
	help
	  Build bzip2, bunzip2, bzcat, etc. tools.

config BZIP2_TESTS
	bool "Build tests"
	default n
	depends on BUILD_TESTS

endif # BZIP2
```

## launcher/Kconfig
```kconfig
# launcher Kconfig - Main launcher application
# Included from main Kconfig

menuconfig LAUNCHER
	bool "Main launcher application"
	default y
	help
	  The ProjT Launcher main application.

if LAUNCHER

menu "Core Components"

config LAUNCHER_CORE
	bool "Core functionality"
	default y
	help
	  Core launcher functionality (required).

config LAUNCHER_GUI
	bool "GUI (Qt Widgets)"
	default y
	help
	  Qt-based graphical user interface.

config LAUNCHER_CLI
	bool "Command-line interface"
	default n
	help
	  Command-line interface for headless operation.

endmenu

menu "Instance Management"

config LAUNCHER_INSTANCES
	bool "Instance management"
	default y
	help
	  Minecraft instance creation and management.

config LAUNCHER_INSTANCE_COPY
	bool "Instance copy/clone"
	default y
	depends on LAUNCHER_INSTANCES

config LAUNCHER_INSTANCE_EXPORT
	bool "Instance export"
	default y
	depends on LAUNCHER_INSTANCES
	help
	  Export instances as archives.

config LAUNCHER_INSTANCE_IMPORT
	bool "Instance import"
	default y
	depends on LAUNCHER_INSTANCES
	help
	  Import instances from archives.

config LAUNCHER_INSTANCE_SYMLINKS
	bool "Linked instances"
	default y
	depends on LAUNCHER_INSTANCES
	help
	  Support for linked instances (shared files).

endmenu

menu "Minecraft Support"

config LAUNCHER_MINECRAFT_VANILLA
	bool "Vanilla Minecraft"
	default y
	help
	  Support for vanilla Minecraft versions.

config LAUNCHER_MINECRAFT_FORGE
	bool "Forge support"
	default y
	help
	  Support for Minecraft Forge modloader.

config LAUNCHER_MINECRAFT_FABRIC
	bool "Fabric support"
	default y
	help
	  Support for Fabric modloader.

config LAUNCHER_MINECRAFT_QUILT
	bool "Quilt support"
	default y
	help
	  Support for Quilt modloader.

config LAUNCHER_MINECRAFT_NEOFORGE
	bool "NeoForge support"
	default y
	help
	  Support for NeoForge modloader.

config LAUNCHER_MINECRAFT_LITELOADER
	bool "LiteLoader support"
	default y
	help
	  Support for LiteLoader (legacy).

endmenu

menu "Mod Platforms"

config LAUNCHER_MODRINTH
	bool "Modrinth integration"
	default y
	help
	  Modrinth mod/modpack platform support.

config LAUNCHER_CURSEFORGE
	bool "CurseForge/Flame integration"
	default y
	help
	  CurseForge mod/modpack platform support.

config LAUNCHER_TECHNIC
	bool "Technic integration"
	default y
	help
	  Technic platform modpack support.

config LAUNCHER_ATLAUNCHER
	bool "ATLauncher integration"
	default y
	help
	  ATLauncher modpack support.

config LAUNCHER_FTB
	bool "Feed The Beast integration"
	default y
	help
	  FTB modpack support.

endmenu

menu "Authentication"

config LAUNCHER_AUTH_MSA
	bool "Microsoft Account login"
	default y
	help
	  Microsoft/Xbox Live authentication.

config LAUNCHER_AUTH_OFFLINE
	bool "Offline mode"
	default y
	help
	  Allow offline play without authentication.

config LAUNCHER_AUTH_ELY_BY
	bool "Ely.by authentication"
	default n
	help
	  Ely.by authentication service support.

endmenu

menu "UI Features"

config LAUNCHER_THEMES
	bool "Custom themes"
	default y
	help
	  User-customizable themes.

config LAUNCHER_ICONS
	bool "Custom icon packs"
	default y
	help
	  Custom instance icon support.

config LAUNCHER_SCREENSHOTS
	bool "Screenshot viewer"
	default y
	help
	  In-app screenshot viewing and management.

config LAUNCHER_LOGS
	bool "Log viewer"
	default y
	help
	  In-app log viewing and upload.

config LAUNCHER_CONSOLE
	bool "Console output"
	default y
	help
	  Game console output display.

config LAUNCHER_NEWS
	bool "News feed"
	default y
	help
	  News feed from project website.

config LAUNCHER_CATS
	bool "Cat mode"
	default y
	help
	  Essential cat-related functionality.

endmenu

menu "Java Management"

config LAUNCHER_JAVA_DETECT
	bool "Java detection"
	default y
	help
	  Automatic Java installation detection.

config LAUNCHER_JAVA_DOWNLOAD
	bool "Java auto-download"
	default y
	help
	  Automatic Java download and installation.

config LAUNCHER_JAVA_ADOPTIUM
	bool "Adoptium Temurin"
	default y
	depends on LAUNCHER_JAVA_DOWNLOAD

config LAUNCHER_JAVA_AZUL
	bool "Azul Zulu"
	default y
	depends on LAUNCHER_JAVA_DOWNLOAD

config LAUNCHER_JAVA_MICROSOFT
	bool "Microsoft OpenJDK"
	default y
	depends on LAUNCHER_JAVA_DOWNLOAD

endmenu

menu "Updates"

config LAUNCHER_UPDATER
	bool "Auto-updater"
	default y
	help
	  In-app self-update functionality.

config LAUNCHER_UPDATER_GITHUB
	bool "GitHub releases"
	default y
	depends on LAUNCHER_UPDATER

config LAUNCHER_UPDATER_SPARKLE
	bool "Sparkle (macOS)"
	default y
	depends on LAUNCHER_UPDATER && TARGET_MACOS

endmenu

menu "Integrations"

config LAUNCHER_DISCORD_RPC
	bool "Discord Rich Presence"
	default y
	help
	  Show game status in Discord.

config LAUNCHER_GAMEMODE
	bool "GameMode integration"
	default y
	depends on TARGET_LINUX || TARGET_AUTO
	help
	  Feral GameMode performance optimization.

config LAUNCHER_MANGOHUD
	bool "MangoHud integration"
	default y
	depends on TARGET_LINUX || TARGET_AUTO
	help
	  MangoHud performance overlay support.

endmenu

endif # LAUNCHER
```

## libqrencode/Kconfig
```kconfig
# libqrencode Kconfig - QR Code generator
# Included from main Kconfig

menuconfig LIBQRENCODE
	bool "libqrencode - QR Code generator"
	default y
	help
	  QR Code encoding library for generating QR codes.
	  Used for device linking and sharing features.

if LIBQRENCODE

config LIBQRENCODE_VERSION
	string "libqrencode version"
	default "4.1.1"

menu "Features"

config LIBQRENCODE_MICRO_QR
	bool "Micro QR Code support"
	default y
	help
	  Enable Micro QR Code encoding (smaller codes).

config LIBQRENCODE_STRUCTURED_APPEND
	bool "Structured append mode"
	default y
	help
	  Enable structured append for splitting data across
	  multiple QR codes.

config LIBQRENCODE_ECI
	bool "Extended Channel Interpretation (ECI)"
	default y
	help
	  Enable ECI mode for character set specification.

config LIBQRENCODE_8BIT
	bool "8-bit data mode"
	default y
	help
	  Enable 8-bit byte mode for arbitrary data.

config LIBQRENCODE_KANJI
	bool "Kanji mode"
	default y
	help
	  Enable Kanji character encoding mode.

endmenu

menu "Error Correction"

choice
	prompt "Default error correction level"
	default LIBQRENCODE_EC_M

config LIBQRENCODE_EC_L
	bool "Level L (~7% recovery)"

config LIBQRENCODE_EC_M
	bool "Level M (~15% recovery)"

config LIBQRENCODE_EC_Q
	bool "Level Q (~25% recovery)"

config LIBQRENCODE_EC_H
	bool "Level H (~30% recovery)"

endchoice

endmenu

menu "Threading"

config LIBQRENCODE_THREAD_SAFETY
	bool "Thread-safe encoding"
	default y
	help
	  Enable thread-safe QR code generation.
	  Uses pthread for mutex locking.

endmenu

menu "Output Formats"

config LIBQRENCODE_PNG
	bool "PNG output support"
	default y
	depends on LIB_LIBPNG
	help
	  Enable PNG image output (requires libpng).

config LIBQRENCODE_SVG
	bool "SVG output support"
	default y
	help
	  Enable SVG vector output.

config LIBQRENCODE_EPS
	bool "EPS output support"
	default n
	help
	  Enable Encapsulated PostScript output.

config LIBQRENCODE_XPM
	bool "XPM output support"
	default n
	help
	  Enable X PixMap output.

config LIBQRENCODE_ANSI
	bool "ANSI terminal output"
	default y
	help
	  Enable ANSI terminal text output.

config LIBQRENCODE_ASCII
	bool "ASCII text output"
	default y
	help
	  Enable plain ASCII text output.

config LIBQRENCODE_UTF8
	bool "UTF-8 text output"
	default y
	help
	  Enable UTF-8 block character output.

endmenu

config LIBQRENCODE_TOOLS
	bool "Build qrencode command-line tool"
	default n
	help
	  Build the qrencode CLI tool.

endif # LIBQRENCODE
```
